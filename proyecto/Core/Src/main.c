/* USER CODE BEGIN Header */
/**
  ******************************************************************************
  * @file           : main.c
  * @brief          : Main program body
  ******************************************************************************
  * @attention
  *
  * Copyright (c) 2025 STMicroelectronics.
  * All rights reserved.
  *
  * This software is licensed under terms that can be found in the LICENSE file
  * in the root directory of this software component.
  * If no LICENSE file comes with this software, it is provided AS-IS.
  *
  ******************************************************************************
  */
/* USER CODE END Header */
/* Includes ------------------------------------------------------------------*/
#include "main.h"

/* Private includes ----------------------------------------------------------*/
/* USER CODE BEGIN Includes */

/* USER CODE END Includes */

/* Private typedef -----------------------------------------------------------*/
/* USER CODE BEGIN PTD */

/* USER CODE END PTD */

/* Private define ------------------------------------------------------------*/
/* USER CODE BEGIN PD */

/* USER CODE END PD */

/* Private macro -------------------------------------------------------------*/
/* USER CODE BEGIN PM */

/* USER CODE END PM */

/* Private variables ---------------------------------------------------------*/
I2C_HandleTypeDef hi2c1;

TIM_HandleTypeDef htim2;
TIM_HandleTypeDef htim3;
TIM_HandleTypeDef htim4;
TIM_HandleTypeDef htim5;
TIM_HandleTypeDef htim9;
TIM_HandleTypeDef htim10;

UART_HandleTypeDef huart2;

/* USER CODE BEGIN PV */
//Inicializamos la variable a la cual vamos a gurdarle el estado que
//tiene la maquina
estadoActual fsm ={0};

//Variables del posible estado para los finales de carrera
uint8_t estadoIzquierdo =0;
uint8_t estadoDerecho =0;

//Creamos los formatos para las expresiones
//Carita "delado"
const unsigned char delado [] = {
	0xff, 0xff, 0xff, 0xff, 0xff, 0xff, 0xff, 0xff, 0xff, 0xff, 0xff, 0xff, 0xff, 0xff, 0xff, 0xff,
	0xff, 0xff, 0xff, 0xff, 0xff, 0xff, 0xff, 0xff, 0xff, 0xff, 0xff, 0xff, 0xff, 0xff, 0xff, 0xff,
	0xff, 0xff, 0xff, 0xff, 0xff, 0xff, 0xff, 0xff, 0xff, 0xff, 0xff, 0xff, 0xff, 0xff, 0xff, 0xff,
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	0xff, 0xff, 0xff, 0xff, 0xff, 0xff, 0xff, 0xff, 0xff, 0xff, 0xff, 0xff, 0xff, 0xff, 0xff, 0xff
};

//Carita "enamoradisimo"
const unsigned char enamoradisimo [] = {
	0xff, 0xff, 0xff, 0xff, 0xff, 0xff, 0xff, 0xff, 0xff, 0xff, 0xff, 0xff, 0xff, 0xff, 0xff, 0xff,
	0xff, 0xff, 0xff, 0xff, 0xff, 0xff, 0xf8, 0x7f, 0xe1, 0xff, 0xff, 0xff, 0xff, 0xff, 0xff, 0xff,
	0xff, 0xff, 0xff, 0xff, 0xff, 0xff, 0xe0, 0x7f, 0xe0, 0x7f, 0xff, 0xff, 0xff, 0xff, 0xff, 0xff,
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	0xff, 0xff, 0xff, 0xff, 0xff, 0xff, 0xff, 0xff, 0xff, 0xff, 0xff, 0xff, 0xff, 0xff, 0xff, 0xff
};

//Carita "medio-triste"
const unsigned char medioTriste [] = {
	0xff, 0xff, 0xff, 0xff, 0xff, 0xff, 0xff, 0xff, 0xff, 0xff, 0xff, 0xff, 0xff, 0xff, 0xff, 0xff,
	0xff, 0xff, 0xff, 0xff, 0xff, 0xff, 0xff, 0xff, 0xff, 0xff, 0xff, 0xff, 0xff, 0xff, 0xff, 0xff,
	0xff, 0xff, 0xff, 0xff, 0xff, 0xff, 0xff, 0xff, 0xff, 0xff, 0xff, 0xff, 0xff, 0xff, 0xff, 0xff,
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	0xff, 0xff, 0xff, 0xff, 0xff, 0xff, 0xff, 0xff, 0xff, 0xff, 0xff, 0xff, 0xff, 0xff, 0xff, 0xff
};

// cara "enamoradito"
const unsigned char enamoradito []= {
	0xff, 0xff, 0xff, 0xff, 0xff, 0xff, 0xff, 0xff, 0xff, 0xff, 0xff, 0xff, 0xff, 0xff, 0xff, 0xff,
	0xff, 0xff, 0xff, 0xff, 0xff, 0xff, 0xff, 0xff, 0xff, 0xff, 0xfd, 0xfc, 0xff, 0xff, 0xff, 0xff,
	0xff, 0xff, 0xff, 0xff, 0xff, 0xff, 0xff, 0xff, 0xff, 0xff, 0xf0, 0x70, 0x3f, 0xff, 0xff, 0xff,
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	0xff, 0xff, 0xff, 0xff, 0xff, 0xff, 0xff, 0xff, 0xff, 0xff, 0xff, 0xff, 0xff, 0xff, 0xff, 0xff
};

// 'bravo', 128x64px
const unsigned char bravo [] = {
	0xff, 0xff, 0xff, 0xff, 0xff, 0xff, 0xff, 0xff, 0xff, 0xff, 0xff, 0xff, 0xff, 0xff, 0xff, 0xff,
	0xff, 0xff, 0xff, 0xff, 0xff, 0xff, 0xff, 0xff, 0xff, 0xff, 0xff, 0xff, 0xff, 0xff, 0xff, 0xff,
	0xff, 0xff, 0xff, 0xff, 0xff, 0xff, 0xff, 0xff, 0xff, 0xff, 0xff, 0xff, 0xff, 0xff, 0xff, 0xff,
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	0xff, 0xff, 0xff, 0xff, 0xff, 0xff, 0xff, 0xff, 0xff, 0xff, 0xff, 0xff, 0xff, 0xff, 0xff, 0xff
};
// 'contando', 128x64px
const unsigned char contando [] = {
	0xff, 0xff, 0xff, 0xff, 0xff, 0xff, 0xff, 0xff, 0xff, 0xff, 0xff, 0xff, 0xff, 0xff, 0xff, 0xff,
	0xff, 0xff, 0xff, 0xff, 0xff, 0xff, 0xff, 0xff, 0xff, 0xff, 0xff, 0xff, 0xff, 0xff, 0xff, 0xff,
	0xff, 0xff, 0xff, 0xff, 0xff, 0xff, 0xff, 0xff, 0xff, 0xff, 0xff, 0xff, 0xff, 0xff, 0xff, 0xff,
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	0xff, 0xff, 0xff, 0xff, 0xff, 0xff, 0xff, 0xff, 0xff, 0xff, 0xff, 0xff, 0xff, 0xff, 0xff, 0xff
};
// 'enojado', 128x64px
const unsigned char enojado []  = {
	0xff, 0xff, 0xff, 0xff, 0xff, 0xff, 0xff, 0xff, 0xff, 0xff, 0xff, 0xff, 0xff, 0xff, 0xff, 0xff,
	0xff, 0xff, 0xff, 0xff, 0xff, 0xff, 0xff, 0xff, 0xff, 0xff, 0xff, 0xff, 0xff, 0xff, 0xff, 0xff,
	0xff, 0xff, 0xff, 0xff, 0xff, 0xff, 0xff, 0xff, 0xff, 0xff, 0xff, 0xff, 0xff, 0xff, 0xff, 0xff,
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	0xff, 0xff, 0xff, 0xff, 0xff, 0xff, 0xff, 0xff, 0xff, 0xff, 0xff, 0xff, 0xff, 0xff, 0xff, 0xff
};

// 'emocionado', 128x64px
const unsigned char emocionado [] = {
	0xff, 0xff, 0xff, 0xff, 0xff, 0xff, 0xff, 0xff, 0xff, 0xff, 0xff, 0xff, 0xff, 0xff, 0xff, 0xff,
	0xff, 0xff, 0xff, 0xff, 0xff, 0xff, 0xff, 0xff, 0xff, 0xff, 0xff, 0xff, 0xff, 0xff, 0xff, 0xff,
	0xff, 0xff, 0xff, 0xff, 0xff, 0xff, 0xff, 0xff, 0xff, 0xff, 0xff, 0xff, 0xff, 0xff, 0xff, 0xff,
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	0xff, 0xff, 0xff, 0xff, 0xff, 0xff, 0xff, 0xff, 0xff, 0xff, 0xff, 0xff, 0xff, 0xff, 0xff, 0xff
};

// 'desesperado', 128x64px
const unsigned char desesperado [] = {
	0xff, 0xff, 0xff, 0xff, 0xff, 0xff, 0xff, 0xff, 0xff, 0xff, 0xff, 0xff, 0xff, 0xff, 0xff, 0xff,
	0xff, 0xff, 0xff, 0xff, 0xff, 0xff, 0xff, 0xff, 0xff, 0xff, 0xff, 0xff, 0xff, 0xff, 0xff, 0xff,
	0xff, 0xff, 0xff, 0xff, 0xff, 0xff, 0xff, 0xff, 0xff, 0xff, 0xff, 0xff, 0xff, 0xff, 0xff, 0xff,
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	0xff, 0xff, 0xff, 0xff, 0xff, 0xff, 0xff, 0xff, 0xff, 0xff, 0xff, 0xff, 0xff, 0xff, 0xff, 0xff
};

// 'gafas', 128x64px
const unsigned char gafas [] = {
	0xff, 0xff, 0xff, 0xff, 0xff, 0xff, 0xff, 0xff, 0xff, 0xff, 0xff, 0xff, 0xff, 0xff, 0xff, 0xff,
	0xff, 0xff, 0xff, 0xff, 0xff, 0xff, 0xff, 0xff, 0xff, 0xff, 0xff, 0xff, 0xff, 0xff, 0xff, 0xff,
	0xff, 0xff, 0xff, 0xff, 0xff, 0xff, 0xff, 0xff, 0xff, 0xff, 0xff, 0xff, 0xff, 0xff, 0xff, 0xff,
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	0xff, 0xff, 0xff, 0xff, 0xff, 0xff, 0xff, 0xff, 0xff, 0xff, 0xff, 0xff, 0xff, 0xff, 0xff, 0xff
};
// 'oye', 128x64px
const unsigned char oye [] = {
	0xff, 0xff, 0xff, 0xff, 0xff, 0xff, 0xff, 0xff, 0xff, 0xff, 0xff, 0xff, 0xff, 0xff, 0xff, 0xff,
	0xff, 0xff, 0xff, 0xff, 0xff, 0xff, 0xff, 0xff, 0xff, 0xff, 0xff, 0xff, 0xff, 0xff, 0xff, 0xff,
	0xff, 0xff, 0xff, 0xff, 0xff, 0xff, 0xff, 0xff, 0xff, 0xff, 0xff, 0xff, 0xff, 0xff, 0xff, 0xff,
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	0xff, 0xff, 0xff, 0xff, 0xff, 0xff, 0xff, 0xff, 0xff, 0xff, 0xff, 0xff, 0xff, 0xff, 0xff, 0xff
};

// 'triste', 128x64px
const unsigned char triste [] = {
	0xff, 0xff, 0xff, 0xff, 0xff, 0xff, 0xff, 0xff, 0xff, 0xff, 0xff, 0xff, 0xff, 0xff, 0xff, 0xff,
	0xff, 0xff, 0xff, 0xff, 0xff, 0xff, 0xff, 0xff, 0xff, 0xff, 0xff, 0xff, 0xff, 0xff, 0xff, 0xff,
	0xff, 0xff, 0xff, 0xff, 0xff, 0xff, 0xff, 0xff, 0xff, 0xff, 0xff, 0xff, 0xff, 0xff, 0xff, 0xff,
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	0xff, 0xff, 0xff, 0xff, 0xff, 0xff, 0xff, 0xff, 0xff, 0xff, 0xff, 0xff, 0xff, 0xff, 0xff, 0xff
};

// 'guino', 128x64px
const unsigned char guino [] = {
	0xff, 0xff, 0xff, 0xff, 0xff, 0xff, 0xff, 0xff, 0xff, 0xff, 0xff, 0xff, 0xff, 0xff, 0xff, 0xff,
	0xff, 0xff, 0xff, 0xff, 0xff, 0xff, 0xff, 0xff, 0xff, 0xff, 0xff, 0xff, 0xff, 0xff, 0xff, 0xff,
	0xff, 0xff, 0xff, 0xff, 0xff, 0xff, 0xff, 0xff, 0xff, 0xff, 0xff, 0xff, 0xff, 0xff, 0xff, 0xff,
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	0xff, 0xff, 0xff, 0xff, 0xff, 0xff, 0xff, 0xff, 0xff, 0xff, 0xff, 0xff, 0xff, 0xff, 0xff, 0xff
};

//Definimos el tamano del buffer donde se va a almacenar el menu
#define MENU_BUFFER_SIZE 1150
//Definimos la variable que nos indica el tamano de los buffer recibidos
#define UART_RX_BUFFER_SIZE 64
//Definimos el numero de capitulos posible
#define NUM_OPCIONES 3
char* opciones_menu[NUM_OPCIONES] = {
    "Cap 1. Dos seres",
    "Cap 2. La mar...",
    "Cap 3. El origen"
};
//Variable para contar los periodos del Timer3
volatile uint8_t contador=0;

//Variable para asignar la opcion actual de capitulo
volatile uint8_t opcion_actual =0;

/* USER CODE END PV */

/* Private function prototypes -----------------------------------------------*/
void SystemClock_Config(void);
static void MX_GPIO_Init(void);
static void MX_USART2_UART_Init(void);
static void MX_TIM2_Init(void);
static void MX_I2C1_Init(void);
static void MX_TIM3_Init(void);
static void MX_TIM4_Init(void);
static void MX_TIM5_Init(void);
static void MX_TIM9_Init(void);
static void MX_TIM10_Init(void);
/* USER CODE BEGIN PFP */
//Funcion de maquina de estados
void maquinaEstados (void);
//Funciones para definir las acciones de cada capitulo
void acciones1 (void);
void acciones2 (void);
void acciones3 (void);
//Funcion para mostrar el menu en pantalla
void mostrar_menu (void);
//Funcion para cambiar la opcion_actual
uint16_t cambioNumero (uint16_t numeroLocal);
//Funcion para dar inicio al show
void queComienceElShow (void);
/* USER CODE END PFP */

/* Private user code ---------------------------------------------------------*/
/* USER CODE BEGIN 0 */

/* USER CODE END 0 */

/**
  * @brief  The application entry point.
  * @retval int
  */
int main(void)
{
  /* USER CODE BEGIN 1 */

  /* USER CODE END 1 */

  /* MCU Configuration--------------------------------------------------------*/

  /* Reset of all peripherals, Initializes the Flash interface and the Systick. */
  HAL_Init();

  /* USER CODE BEGIN Init */

  /* USER CODE END Init */

  /* Configure the system clock */
  SystemClock_Config();

  /* USER CODE BEGIN SysInit */

  /* USER CODE END SysInit */

  /* Initialize all configured peripherals */
  MX_GPIO_Init();
  MX_USART2_UART_Init();
  MX_TIM2_Init();
  MX_I2C1_Init();
  MX_TIM3_Init();
  MX_TIM4_Init();
  MX_TIM5_Init();
  MX_TIM9_Init();
  MX_TIM10_Init();
  /* USER CODE BEGIN 2 */
  //Inicializamos los timers y sus interrupciones
  HAL_TIM_Base_Start_IT(&htim2);
  //Inicializamos la pantalla
  ssd1306_Init();
  //Inicializamos el timer y su respectivo PWM para el motor
  HAL_GPIO_WritePin(enable_GPIO_Port, enable_Pin, GPIO_PIN_SET);
  HAL_TIM_Base_Start(&htim4);
  HAL_TIM_PWM_Start(&htim4, TIM_CHANNEL_2);
  fsm.estado = menu;
  HAL_TIM_PWM_Stop(&htim4, TIM_CHANNEL_2);



  /* USER CODE END 2 */

  /* Infinite loop */
  /* USER CODE BEGIN WHILE */
  while (1)
  {
    /* USER CODE END WHILE */

    /* USER CODE BEGIN 3 */
		  maquinaEstados();
	  }

  /* USER CODE END 3 */
}

/**
  * @brief System Clock Configuration
  * @retval None
  */
void SystemClock_Config(void)
{
  RCC_OscInitTypeDef RCC_OscInitStruct = {0};
  RCC_ClkInitTypeDef RCC_ClkInitStruct = {0};

  /** Configure the main internal regulator output voltage
  */
  __HAL_RCC_PWR_CLK_ENABLE();
  __HAL_PWR_VOLTAGESCALING_CONFIG(PWR_REGULATOR_VOLTAGE_SCALE1);

  /** Initializes the RCC Oscillators according to the specified parameters
  * in the RCC_OscInitTypeDef structure.
  */
  RCC_OscInitStruct.OscillatorType = RCC_OSCILLATORTYPE_HSI;
  RCC_OscInitStruct.HSIState = RCC_HSI_ON;
  RCC_OscInitStruct.HSICalibrationValue = RCC_HSICALIBRATION_DEFAULT;
  RCC_OscInitStruct.PLL.PLLState = RCC_PLL_NONE;
  if (HAL_RCC_OscConfig(&RCC_OscInitStruct) != HAL_OK)
  {
    Error_Handler();
  }

  /** Initializes the CPU, AHB and APB buses clocks
  */
  RCC_ClkInitStruct.ClockType = RCC_CLOCKTYPE_HCLK|RCC_CLOCKTYPE_SYSCLK
                              |RCC_CLOCKTYPE_PCLK1|RCC_CLOCKTYPE_PCLK2;
  RCC_ClkInitStruct.SYSCLKSource = RCC_SYSCLKSOURCE_HSI;
  RCC_ClkInitStruct.AHBCLKDivider = RCC_SYSCLK_DIV1;
  RCC_ClkInitStruct.APB1CLKDivider = RCC_HCLK_DIV2;
  RCC_ClkInitStruct.APB2CLKDivider = RCC_HCLK_DIV1;

  if (HAL_RCC_ClockConfig(&RCC_ClkInitStruct, FLASH_LATENCY_0) != HAL_OK)
  {
    Error_Handler();
  }
}

/**
  * @brief I2C1 Initialization Function
  * @param None
  * @retval None
  */
static void MX_I2C1_Init(void)
{

  /* USER CODE BEGIN I2C1_Init 0 */

  /* USER CODE END I2C1_Init 0 */

  /* USER CODE BEGIN I2C1_Init 1 */

  /* USER CODE END I2C1_Init 1 */
  hi2c1.Instance = I2C1;
  hi2c1.Init.ClockSpeed = 400000;
  hi2c1.Init.DutyCycle = I2C_DUTYCYCLE_16_9;
  hi2c1.Init.OwnAddress1 = 0;
  hi2c1.Init.AddressingMode = I2C_ADDRESSINGMODE_7BIT;
  hi2c1.Init.DualAddressMode = I2C_DUALADDRESS_DISABLE;
  hi2c1.Init.OwnAddress2 = 0;
  hi2c1.Init.GeneralCallMode = I2C_GENERALCALL_DISABLE;
  hi2c1.Init.NoStretchMode = I2C_NOSTRETCH_DISABLE;
  if (HAL_I2C_Init(&hi2c1) != HAL_OK)
  {
    Error_Handler();
  }
  /* USER CODE BEGIN I2C1_Init 2 */

  /* USER CODE END I2C1_Init 2 */

}

/**
  * @brief TIM2 Initialization Function
  * @param None
  * @retval None
  */
static void MX_TIM2_Init(void)
{

  /* USER CODE BEGIN TIM2_Init 0 */

  /* USER CODE END TIM2_Init 0 */

  TIM_ClockConfigTypeDef sClockSourceConfig = {0};
  TIM_MasterConfigTypeDef sMasterConfig = {0};

  /* USER CODE BEGIN TIM2_Init 1 */

  /* USER CODE END TIM2_Init 1 */
  htim2.Instance = TIM2;
  htim2.Init.Prescaler = 16000-1;
  htim2.Init.CounterMode = TIM_COUNTERMODE_UP;
  htim2.Init.Period = 250-1;
  htim2.Init.ClockDivision = TIM_CLOCKDIVISION_DIV1;
  htim2.Init.AutoReloadPreload = TIM_AUTORELOAD_PRELOAD_DISABLE;
  if (HAL_TIM_Base_Init(&htim2) != HAL_OK)
  {
    Error_Handler();
  }
  sClockSourceConfig.ClockSource = TIM_CLOCKSOURCE_INTERNAL;
  if (HAL_TIM_ConfigClockSource(&htim2, &sClockSourceConfig) != HAL_OK)
  {
    Error_Handler();
  }
  sMasterConfig.MasterOutputTrigger = TIM_TRGO_RESET;
  sMasterConfig.MasterSlaveMode = TIM_MASTERSLAVEMODE_DISABLE;
  if (HAL_TIMEx_MasterConfigSynchronization(&htim2, &sMasterConfig) != HAL_OK)
  {
    Error_Handler();
  }
  /* USER CODE BEGIN TIM2_Init 2 */

  /* USER CODE END TIM2_Init 2 */

}

/**
  * @brief TIM3 Initialization Function
  * @param None
  * @retval None
  */
static void MX_TIM3_Init(void)
{

  /* USER CODE BEGIN TIM3_Init 0 */

  /* USER CODE END TIM3_Init 0 */

  TIM_ClockConfigTypeDef sClockSourceConfig = {0};
  TIM_MasterConfigTypeDef sMasterConfig = {0};
  TIM_OC_InitTypeDef sConfigOC = {0};

  /* USER CODE BEGIN TIM3_Init 1 */

  /* USER CODE END TIM3_Init 1 */
  htim3.Instance = TIM3;
  htim3.Init.Prescaler = 10000-1;
  htim3.Init.CounterMode = TIM_COUNTERMODE_UP;
  htim3.Init.Period = 8000;
  htim3.Init.ClockDivision = TIM_CLOCKDIVISION_DIV1;
  htim3.Init.AutoReloadPreload = TIM_AUTORELOAD_PRELOAD_DISABLE;
  if (HAL_TIM_Base_Init(&htim3) != HAL_OK)
  {
    Error_Handler();
  }
  sClockSourceConfig.ClockSource = TIM_CLOCKSOURCE_INTERNAL;
  if (HAL_TIM_ConfigClockSource(&htim3, &sClockSourceConfig) != HAL_OK)
  {
    Error_Handler();
  }
  if (HAL_TIM_PWM_Init(&htim3) != HAL_OK)
  {
    Error_Handler();
  }
  sMasterConfig.MasterOutputTrigger = TIM_TRGO_RESET;
  sMasterConfig.MasterSlaveMode = TIM_MASTERSLAVEMODE_DISABLE;
  if (HAL_TIMEx_MasterConfigSynchronization(&htim3, &sMasterConfig) != HAL_OK)
  {
    Error_Handler();
  }
  sConfigOC.OCMode = TIM_OCMODE_PWM1;
  sConfigOC.Pulse = 0;
  sConfigOC.OCPolarity = TIM_OCPOLARITY_HIGH;
  sConfigOC.OCFastMode = TIM_OCFAST_DISABLE;
  if (HAL_TIM_PWM_ConfigChannel(&htim3, &sConfigOC, TIM_CHANNEL_4) != HAL_OK)
  {
    Error_Handler();
  }
  /* USER CODE BEGIN TIM3_Init 2 */

  /* USER CODE END TIM3_Init 2 */
  HAL_TIM_MspPostInit(&htim3);

}

/**
  * @brief TIM4 Initialization Function
  * @param None
  * @retval None
  */
static void MX_TIM4_Init(void)
{

  /* USER CODE BEGIN TIM4_Init 0 */

  /* USER CODE END TIM4_Init 0 */

  TIM_ClockConfigTypeDef sClockSourceConfig = {0};
  TIM_MasterConfigTypeDef sMasterConfig = {0};
  TIM_OC_InitTypeDef sConfigOC = {0};

  /* USER CODE BEGIN TIM4_Init 1 */

  /* USER CODE END TIM4_Init 1 */
  htim4.Instance = TIM4;
  htim4.Init.Prescaler = 1600;
  htim4.Init.CounterMode = TIM_COUNTERMODE_UP;
  htim4.Init.Period = 100;
  htim4.Init.ClockDivision = TIM_CLOCKDIVISION_DIV1;
  htim4.Init.AutoReloadPreload = TIM_AUTORELOAD_PRELOAD_DISABLE;
  if (HAL_TIM_Base_Init(&htim4) != HAL_OK)
  {
    Error_Handler();
  }
  sClockSourceConfig.ClockSource = TIM_CLOCKSOURCE_INTERNAL;
  if (HAL_TIM_ConfigClockSource(&htim4, &sClockSourceConfig) != HAL_OK)
  {
    Error_Handler();
  }
  if (HAL_TIM_PWM_Init(&htim4) != HAL_OK)
  {
    Error_Handler();
  }
  sMasterConfig.MasterOutputTrigger = TIM_TRGO_RESET;
  sMasterConfig.MasterSlaveMode = TIM_MASTERSLAVEMODE_DISABLE;
  if (HAL_TIMEx_MasterConfigSynchronization(&htim4, &sMasterConfig) != HAL_OK)
  {
    Error_Handler();
  }
  sConfigOC.OCMode = TIM_OCMODE_PWM1;
  sConfigOC.Pulse = 10;
  sConfigOC.OCPolarity = TIM_OCPOLARITY_HIGH;
  sConfigOC.OCFastMode = TIM_OCFAST_DISABLE;
  if (HAL_TIM_PWM_ConfigChannel(&htim4, &sConfigOC, TIM_CHANNEL_2) != HAL_OK)
  {
    Error_Handler();
  }
  /* USER CODE BEGIN TIM4_Init 2 */

  /* USER CODE END TIM4_Init 2 */
  HAL_TIM_MspPostInit(&htim4);

}

/**
  * @brief TIM5 Initialization Function
  * @param None
  * @retval None
  */
static void MX_TIM5_Init(void)
{

  /* USER CODE BEGIN TIM5_Init 0 */

  /* USER CODE END TIM5_Init 0 */

  TIM_ClockConfigTypeDef sClockSourceConfig = {0};
  TIM_MasterConfigTypeDef sMasterConfig = {0};

  /* USER CODE BEGIN TIM5_Init 1 */

  /* USER CODE END TIM5_Init 1 */
  htim5.Instance = TIM5;
  htim5.Init.Prescaler = 10000-1;
  htim5.Init.CounterMode = TIM_COUNTERMODE_UP;
  htim5.Init.Period = 8000;
  htim5.Init.ClockDivision = TIM_CLOCKDIVISION_DIV1;
  htim5.Init.AutoReloadPreload = TIM_AUTORELOAD_PRELOAD_DISABLE;
  if (HAL_TIM_Base_Init(&htim5) != HAL_OK)
  {
    Error_Handler();
  }
  sClockSourceConfig.ClockSource = TIM_CLOCKSOURCE_INTERNAL;
  if (HAL_TIM_ConfigClockSource(&htim5, &sClockSourceConfig) != HAL_OK)
  {
    Error_Handler();
  }
  sMasterConfig.MasterOutputTrigger = TIM_TRGO_RESET;
  sMasterConfig.MasterSlaveMode = TIM_MASTERSLAVEMODE_DISABLE;
  if (HAL_TIMEx_MasterConfigSynchronization(&htim5, &sMasterConfig) != HAL_OK)
  {
    Error_Handler();
  }
  /* USER CODE BEGIN TIM5_Init 2 */

  /* USER CODE END TIM5_Init 2 */

}

/**
  * @brief TIM9 Initialization Function
  * @param None
  * @retval None
  */
static void MX_TIM9_Init(void)
{

  /* USER CODE BEGIN TIM9_Init 0 */

  /* USER CODE END TIM9_Init 0 */

  TIM_ClockConfigTypeDef sClockSourceConfig = {0};

  /* USER CODE BEGIN TIM9_Init 1 */

  /* USER CODE END TIM9_Init 1 */
  htim9.Instance = TIM9;
  htim9.Init.Prescaler = 10000-1;
  htim9.Init.CounterMode = TIM_COUNTERMODE_UP;
  htim9.Init.Period = 8000;
  htim9.Init.ClockDivision = TIM_CLOCKDIVISION_DIV1;
  htim9.Init.AutoReloadPreload = TIM_AUTORELOAD_PRELOAD_DISABLE;
  if (HAL_TIM_Base_Init(&htim9) != HAL_OK)
  {
    Error_Handler();
  }
  sClockSourceConfig.ClockSource = TIM_CLOCKSOURCE_INTERNAL;
  if (HAL_TIM_ConfigClockSource(&htim9, &sClockSourceConfig) != HAL_OK)
  {
    Error_Handler();
  }
  /* USER CODE BEGIN TIM9_Init 2 */

  /* USER CODE END TIM9_Init 2 */

}

/**
  * @brief TIM10 Initialization Function
  * @param None
  * @retval None
  */
static void MX_TIM10_Init(void)
{

  /* USER CODE BEGIN TIM10_Init 0 */

  /* USER CODE END TIM10_Init 0 */

  /* USER CODE BEGIN TIM10_Init 1 */

  /* USER CODE END TIM10_Init 1 */
  htim10.Instance = TIM10;
  htim10.Init.Prescaler = 16000;
  htim10.Init.CounterMode = TIM_COUNTERMODE_UP;
  htim10.Init.Period = 800;
  htim10.Init.ClockDivision = TIM_CLOCKDIVISION_DIV1;
  htim10.Init.AutoReloadPreload = TIM_AUTORELOAD_PRELOAD_DISABLE;
  if (HAL_TIM_Base_Init(&htim10) != HAL_OK)
  {
    Error_Handler();
  }
  /* USER CODE BEGIN TIM10_Init 2 */

  /* USER CODE END TIM10_Init 2 */

}

/**
  * @brief USART2 Initialization Function
  * @param None
  * @retval None
  */
static void MX_USART2_UART_Init(void)
{

  /* USER CODE BEGIN USART2_Init 0 */

  /* USER CODE END USART2_Init 0 */

  /* USER CODE BEGIN USART2_Init 1 */

  /* USER CODE END USART2_Init 1 */
  huart2.Instance = USART2;
  huart2.Init.BaudRate = 115200;
  huart2.Init.WordLength = UART_WORDLENGTH_8B;
  huart2.Init.StopBits = UART_STOPBITS_1;
  huart2.Init.Parity = UART_PARITY_NONE;
  huart2.Init.Mode = UART_MODE_TX_RX;
  huart2.Init.HwFlowCtl = UART_HWCONTROL_NONE;
  huart2.Init.OverSampling = UART_OVERSAMPLING_16;
  if (HAL_UART_Init(&huart2) != HAL_OK)
  {
    Error_Handler();
  }
  /* USER CODE BEGIN USART2_Init 2 */

  /* USER CODE END USART2_Init 2 */

}

/**
  * @brief GPIO Initialization Function
  * @param None
  * @retval None
  */
static void MX_GPIO_Init(void)
{
  GPIO_InitTypeDef GPIO_InitStruct = {0};
/* USER CODE BEGIN MX_GPIO_Init_1 */
/* USER CODE END MX_GPIO_Init_1 */

  /* GPIO Ports Clock Enable */
  __HAL_RCC_GPIOC_CLK_ENABLE();
  __HAL_RCC_GPIOH_CLK_ENABLE();
  __HAL_RCC_GPIOA_CLK_ENABLE();
  __HAL_RCC_GPIOB_CLK_ENABLE();
  __HAL_RCC_GPIOD_CLK_ENABLE();

  /*Configure GPIO pin Output Level */
  HAL_GPIO_WritePin(GPIOC, enable_Pin|DIR_Pin, GPIO_PIN_RESET);

  /*Configure GPIO pin Output Level */
  HAL_GPIO_WritePin(blinky_GPIO_Port, blinky_Pin, GPIO_PIN_RESET);

  /*Configure GPIO pins : enable_Pin DIR_Pin */
  GPIO_InitStruct.Pin = enable_Pin|DIR_Pin;
  GPIO_InitStruct.Mode = GPIO_MODE_OUTPUT_PP;
  GPIO_InitStruct.Pull = GPIO_NOPULL;
  GPIO_InitStruct.Speed = GPIO_SPEED_FREQ_LOW;
  HAL_GPIO_Init(GPIOC, &GPIO_InitStruct);

  /*Configure GPIO pin : blinky_Pin */
  GPIO_InitStruct.Pin = blinky_Pin;
  GPIO_InitStruct.Mode = GPIO_MODE_OUTPUT_PP;
  GPIO_InitStruct.Pull = GPIO_NOPULL;
  GPIO_InitStruct.Speed = GPIO_SPEED_FREQ_LOW;
  HAL_GPIO_Init(blinky_GPIO_Port, &GPIO_InitStruct);

  /*Configure GPIO pins : finalIzquierdo_Pin switch_Pin finalDerecho_Pin */
  GPIO_InitStruct.Pin = finalIzquierdo_Pin|switch_Pin|finalDerecho_Pin;
  GPIO_InitStruct.Mode = GPIO_MODE_IT_RISING;
  GPIO_InitStruct.Pull = GPIO_NOPULL;
  HAL_GPIO_Init(GPIOA, &GPIO_InitStruct);

  /*Configure GPIO pin : DATA_Pin */
  GPIO_InitStruct.Pin = DATA_Pin;
  GPIO_InitStruct.Mode = GPIO_MODE_INPUT;
  GPIO_InitStruct.Pull = GPIO_NOPULL;
  HAL_GPIO_Init(DATA_GPIO_Port, &GPIO_InitStruct);

  /*Configure GPIO pin : clock_Pin */
  GPIO_InitStruct.Pin = clock_Pin;
  GPIO_InitStruct.Mode = GPIO_MODE_IT_RISING;
  GPIO_InitStruct.Pull = GPIO_NOPULL;
  HAL_GPIO_Init(clock_GPIO_Port, &GPIO_InitStruct);

  /* EXTI interrupt init*/
  HAL_NVIC_SetPriority(EXTI2_IRQn, 0, 0);
  HAL_NVIC_EnableIRQ(EXTI2_IRQn);

  HAL_NVIC_SetPriority(EXTI9_5_IRQn, 0, 0);
  HAL_NVIC_EnableIRQ(EXTI9_5_IRQn);

/* USER CODE BEGIN MX_GPIO_Init_2 */
/* USER CODE END MX_GPIO_Init_2 */
}

/* USER CODE BEGIN 4 */
//FUncion de maquina de estados
void maquinaEstados (void){
	switch (fsm.estado){
	case reproducirAudio:{
		queComienceElShow();
		fsm.estado = IDLE;
		break;
	}
	case capitulo1:{
		acciones1();
		fsm.estado = IDLE;
		break;
	}
	case capitulo2: {
		acciones2();
		fsm.estado = IDLE;
		break;
	}
	case capitulo3:{
		acciones3();
		fsm.estado = IDLE;
		break;
	}
	case menu:{
		mostrar_menu();
		break;
	}
	case cambio_opcion:{
		opcion_actual = cambioNumero(opcion_actual);
		fsm.estado = menu;
		break;
	}
	case apagarMotor:{
		  HAL_GPIO_WritePin(enable_GPIO_Port, enable_Pin, GPIO_PIN_SET);
		  HAL_TIM_PWM_Stop(&htim4,TIM_CHANNEL_2);
		  HAL_TIM_Base_Stop_IT(&htim10);
		  fsm.estado = IDLE;
		  break;
	}
	case Blinky:{
    	HAL_GPIO_TogglePin(blinky_GPIO_Port, blinky_Pin);
    	fsm.estado = IDLE;
		break;
	}
	case IDLE: {
		break;
	}
	default:{
		__NOP();
	}
	}
}
//Funcion para mostrar menu
void mostrar_menu(void) {
    ssd1306_Fill(Black);
	  ssd1306_SetCursor(0, 0);
	  ssd1306_WriteString("Seleccione el cap", Font_7x10, White);

    for (int i = 0; i < NUM_OPCIONES; i++) {
        if (i == opcion_actual) {
            ssd1306_SetCursor(0, (i+2) * 10);
            ssd1306_WriteString(">", Font_6x8, White);
        } else {
            ssd1306_SetCursor(0, (i+2) * 10);
            ssd1306_WriteString(" ", Font_6x8, White);
        }

        ssd1306_SetCursor(10, (i+2) * 10);
        ssd1306_WriteString(opciones_menu[i], Font_6x8, White);
    }

    ssd1306_UpdateScreen();
}
//Funcion para cambiar el numero de opcion_actual
uint16_t cambioNumero (uint16_t numeroLocal){
	//Creamos una variable en la cual guardamos el valor del pin
	//donde está el DT
	uint32_t valor_DT = 0;
	//Cargamos el valor del pin en la variable
	valor_DT = HAL_GPIO_ReadPin(DATA_GPIO_Port, DATA_Pin);
	//Comparamos las posibles opciones
	switch (valor_DT){
	//Cuando el pin DT está en o
	case 0: {
		//Nos aseguramos de que el numeroDisplay no vaya a ser menor que cero
		if (numeroLocal==0){
			//Lo devolvemos a 4095
			numeroLocal =2;
			//Retornamos el valor numeroLocal
			return numeroLocal;
		}
		else {
			//Le restamos a numeroDisplay una unidad
			numeroLocal --;
			//Retornamos el valor numeroLocal
			return numeroLocal;
		}
		break;

	}

	case 1: {
		//Nos aseguramos de que el numero no vaya a ser mayor que 3
		if (numeroLocal>=2){
			//Devolvemos el valor de numeroDisplay a 0
			numeroLocal=0;
			//Retornamos el valor numeroLocal
			return numeroLocal;
		}
		else {
			//Le sumamos una unidad a la variable numeroDisplay
			numeroLocal ++;
			//Retornamos el valor numeroLocal
			return numeroLocal;
		}
		break;
	}
	default:{
		//Retornamos el valor numeroLocal
		return numeroLocal;
		break;
	}
	}
}

//Funcion para asignar que expresion queremos en el tiempo determinado
void acciones1 (void){
	switch (contador){
	case 2:{
		  //Inicializamos con la expresion deseada
		  ssd1306_Fill(Black);
		  ssd1306_DrawBitmap(0,0,delado,128,64,White);
		  ssd1306_UpdateScreen();
		break;
	}
	case 3:{
		  HAL_GPIO_WritePin(DIR_GPIO_Port, DIR_Pin, GPIO_PIN_SET);
		  HAL_GPIO_WritePin(enable_GPIO_Port, enable_Pin, GPIO_PIN_RESET);
		  HAL_TIM_PWM_Start(&htim4,TIM_CHANNEL_2);
		  HAL_TIM_Base_Start_IT(&htim10);
		  break;
	}
	case 4:{
		  HAL_GPIO_WritePin(DIR_GPIO_Port, DIR_Pin, GPIO_PIN_RESET);
		  HAL_GPIO_WritePin(enable_GPIO_Port, enable_Pin, GPIO_PIN_RESET);
		  HAL_TIM_PWM_Start(&htim4,TIM_CHANNEL_2);
		  HAL_TIM_Base_Start_IT(&htim10);
		  break;
	}
	case 6:{
		  ssd1306_Fill(Black);
		  ssd1306_DrawBitmap(0,0,enamoradisimo,128,64,White);
		  ssd1306_UpdateScreen();
		break;
	}
	case 8:{
		  HAL_GPIO_WritePin(DIR_GPIO_Port, DIR_Pin, GPIO_PIN_SET);
		  HAL_GPIO_WritePin(enable_GPIO_Port, enable_Pin, GPIO_PIN_RESET);
		  HAL_TIM_PWM_Start(&htim4,TIM_CHANNEL_2);
		  HAL_TIM_Base_Start_IT(&htim10);
		break;
	}
	case 9:{
		  ssd1306_Fill(Black);
		  ssd1306_DrawBitmap(0,0,medioTriste,128,64,White);
		  ssd1306_UpdateScreen();
		break;
	}
	case 12:{
		  HAL_GPIO_WritePin(DIR_GPIO_Port, DIR_Pin, GPIO_PIN_RESET);
		  HAL_GPIO_WritePin(enable_GPIO_Port, enable_Pin, GPIO_PIN_RESET);
		  HAL_TIM_PWM_Start(&htim4,TIM_CHANNEL_2);
		  HAL_TIM_Base_Start_IT(&htim10);
		break;
	}
	case 13:{
		  ssd1306_Fill(Black);
		  ssd1306_DrawBitmap(0,0,enamoradito,128,64,White);
		  ssd1306_UpdateScreen();
		break;
	}
	case 15:{
		  ssd1306_Fill(Black);
		  ssd1306_DrawBitmap(0,0,bravo,128,64,White);
		  ssd1306_UpdateScreen();
		break;
	}
	case 18:{
		  ssd1306_Fill(Black);
		  ssd1306_DrawBitmap(0,0,contando,128,64,White);
		  ssd1306_UpdateScreen();
		break;
	}
	case 21:{
		  HAL_GPIO_WritePin(DIR_GPIO_Port, DIR_Pin, GPIO_PIN_SET);
		  HAL_GPIO_WritePin(enable_GPIO_Port, enable_Pin, GPIO_PIN_RESET);
		  HAL_TIM_PWM_Start(&htim4,TIM_CHANNEL_2);
		  HAL_TIM_Base_Start_IT(&htim10);
		  break;
	}
	case 24:{
		HAL_TIM_Base_Stop_IT(&htim3);
		contador =0;
		mostrar_menu();
		break;
	}
	default:{
		__NOP();
		break;
	}
	}
}
//Funcion para las acciones del capitulo 2
void acciones2 (void){
	switch (contador){
	case 2:{
		  ssd1306_Fill(Black);
		  ssd1306_DrawBitmap(0,0,enojado,128,64,White);
		  ssd1306_UpdateScreen();
		break;
	}
	case 3:{
		  HAL_GPIO_TogglePin(DIR_GPIO_Port, DIR_Pin);
		  HAL_GPIO_WritePin(enable_GPIO_Port, enable_Pin, GPIO_PIN_RESET);
		  HAL_TIM_PWM_Start(&htim4,TIM_CHANNEL_2);
		  HAL_TIM_Base_Start_IT(&htim10);
		break;
	}
	case 5:{
		  ssd1306_Fill(Black);
		  ssd1306_DrawBitmap(0,0,enamoradito,128,64,White);
		  ssd1306_UpdateScreen();
		  break;
	}
	case 7:{
		  HAL_GPIO_TogglePin(DIR_GPIO_Port, DIR_Pin);
		  HAL_GPIO_WritePin(enable_GPIO_Port, enable_Pin, GPIO_PIN_RESET);
		  HAL_TIM_PWM_Start(&htim4,TIM_CHANNEL_2);
		  HAL_TIM_Base_Start_IT(&htim10);
		break;
	}
	case 9:{
		  ssd1306_Fill(Black);
		  ssd1306_DrawBitmap(0,0,emocionado,128,64,White);
		  ssd1306_UpdateScreen();
		  break;
	}
	case 12:{
		  HAL_GPIO_TogglePin(DIR_GPIO_Port, DIR_Pin);
		  HAL_GPIO_WritePin(enable_GPIO_Port, enable_Pin, GPIO_PIN_RESET);
		  HAL_TIM_PWM_Start(&htim4,TIM_CHANNEL_2);
		  HAL_TIM_Base_Start_IT(&htim10);
		break;
	}
	case 13:{
		  ssd1306_Fill(Black);
		  ssd1306_DrawBitmap(0,0,contando,128,64,White);
		  ssd1306_UpdateScreen();
		break;
	}
	case 15:{
		HAL_TIM_Base_Stop_IT(&htim5);
		contador =0;
		mostrar_menu();
		break;
	}
	default:{
		__NOP();
		break;
	}
	}

}
//Funcion para las acciones del capitulo 3
void acciones3 (void){
	switch (contador){
	case 2:{
		  ssd1306_Fill(Black);
		  ssd1306_DrawBitmap(0,0,bravo,128,64,White);
		  ssd1306_UpdateScreen();
		break;
	}
	case 3:{
		  ssd1306_Fill(Black);
		  ssd1306_DrawBitmap(0,0,enojado,128,64,White);
		  ssd1306_UpdateScreen();
		break;
	}
	case 6:{
		  HAL_GPIO_TogglePin(DIR_GPIO_Port, DIR_Pin);
		  HAL_GPIO_WritePin(enable_GPIO_Port, enable_Pin, GPIO_PIN_RESET);
		  HAL_TIM_PWM_Start(&htim4,TIM_CHANNEL_2);
		  HAL_TIM_Base_Start_IT(&htim10);
		break;
	}
	case 8:{
		  HAL_GPIO_TogglePin(DIR_GPIO_Port, DIR_Pin);
		  HAL_GPIO_WritePin(enable_GPIO_Port, enable_Pin, GPIO_PIN_RESET);
		  HAL_TIM_PWM_Start(&htim4,TIM_CHANNEL_2);
		  HAL_TIM_Base_Start_IT(&htim10);
		break;
	}
	case 10:{
		  ssd1306_Fill(Black);
		  ssd1306_DrawBitmap(0,0,desesperado,128,64,White);
		  ssd1306_UpdateScreen();
		break;
	}
	case 12:{
		  ssd1306_Fill(Black);
		  ssd1306_DrawBitmap(0,0,contando,128,64,White);
		  ssd1306_UpdateScreen();
		break;
	}
	case 13:{
		  HAL_GPIO_TogglePin(DIR_GPIO_Port, DIR_Pin);
		  HAL_GPIO_WritePin(enable_GPIO_Port, enable_Pin, GPIO_PIN_RESET);
		  HAL_TIM_PWM_Start(&htim4,TIM_CHANNEL_2);
		  HAL_TIM_Base_Start_IT(&htim10);
		break;
	}
	case 15:{
		  ssd1306_Fill(Black);
		  ssd1306_DrawBitmap(0,0,enamoradito,128,64,White);
		  ssd1306_UpdateScreen();
		break;
	}
	case 18:{
		  HAL_GPIO_TogglePin(DIR_GPIO_Port, DIR_Pin);
		  HAL_GPIO_WritePin(enable_GPIO_Port, enable_Pin, GPIO_PIN_RESET);
		  HAL_TIM_PWM_Start(&htim4,TIM_CHANNEL_2);
		  HAL_TIM_Base_Start_IT(&htim10);
		break;
	}
	case 21:{
		  ssd1306_Fill(Black);
		  ssd1306_DrawBitmap(0,0,gafas,128,64,White);
		  ssd1306_UpdateScreen();
		break;
	}
	case 24:{
		  ssd1306_Fill(Black);
		  ssd1306_DrawBitmap(0,0,oye,128,64,White);
		  ssd1306_UpdateScreen();
		break;
	}
	case 25:{
		  HAL_GPIO_TogglePin(DIR_GPIO_Port, DIR_Pin);
		  HAL_GPIO_WritePin(enable_GPIO_Port, enable_Pin, GPIO_PIN_RESET);
		  HAL_TIM_PWM_Start(&htim4,TIM_CHANNEL_2);
		  HAL_TIM_Base_Start_IT(&htim10);
		break;
	}
	case 28:{
		  ssd1306_Fill(Black);
		  ssd1306_DrawBitmap(0,0,delado,128,64,White);
		  ssd1306_UpdateScreen();
		break;
	}
	case 30:{
		  ssd1306_Fill(Black);
		  ssd1306_DrawBitmap(0,0,gafas,128,64,White);
		  ssd1306_UpdateScreen();
		break;
	}
	case 32:{
		  ssd1306_Fill(Black);
		  ssd1306_DrawBitmap(0,0,contando,128,64,White);
		  ssd1306_UpdateScreen();
		break;
	}
	case 34:{
		  HAL_GPIO_TogglePin(DIR_GPIO_Port, DIR_Pin);
		  HAL_GPIO_WritePin(enable_GPIO_Port, enable_Pin, GPIO_PIN_RESET);
		  HAL_TIM_PWM_Start(&htim4,TIM_CHANNEL_2);
		  HAL_TIM_Base_Start_IT(&htim10);
		break;
	}
	case 36:{
		  ssd1306_Fill(Black);
		  ssd1306_DrawBitmap(0,0,triste,128,64,White);
		  ssd1306_UpdateScreen();
		break;
	}
	case 39:{
		  HAL_GPIO_TogglePin(DIR_GPIO_Port, DIR_Pin);
		  HAL_GPIO_WritePin(enable_GPIO_Port, enable_Pin, GPIO_PIN_RESET);
		  HAL_TIM_PWM_Start(&htim4,TIM_CHANNEL_2);
		  HAL_TIM_Base_Start_IT(&htim10);
		break;
	}
	case 42:{
		  ssd1306_Fill(Black);
		  ssd1306_DrawBitmap(0,0,guino,128,64,White);
		  ssd1306_UpdateScreen();
		break;
	}
	case 43:{
		HAL_TIM_Base_Stop_IT(&htim9);
		contador =0;
		mostrar_menu();
		break;
	}
	default:{
		__NOP();
		break;
	}
	}
}

//Funcion para enviar el comando
void queComienceElShow (void){
	switch (opcion_actual){
	case 0:{
		HAL_TIM_Base_Start_IT(&htim3);
		//Guardamos la palabra CAP1 para reproducir el audio
		  char msg[] = "CAP1\n";
		  //Transmitimos el audio
		  HAL_UART_Transmit(&huart2, (uint8_t*)msg, strlen(msg), HAL_MAX_DELAY);
		  HAL_Delay(500);
		break;
	}
	case 1:{
		HAL_TIM_Base_Start_IT(&htim5);
		//Guardamos la palabra CAP2 para reproducir el audio
		  char msg[] = "CAP2\n";
		  //Transmitimos el audio
		  HAL_UART_Transmit(&huart2, (uint8_t*)msg, strlen(msg), HAL_MAX_DELAY);
		  HAL_Delay(500);
		break;
	}
	case 2:{
		 HAL_TIM_Base_Start_IT(&htim9);
		//Guardamos la palabra CAP3 para reproducir el audio
		  char msg[] = "CAP3\n";
		  HAL_UART_Transmit(&huart2, (uint8_t*)msg, strlen(msg), HAL_MAX_DELAY);
		  HAL_Delay(500);
		break;
	}
	default:{
		__NOP();
		break;
	}
	}
}

//Callback para el EXTI
void HAL_GPIO_EXTI_Callback(uint16_t GPIO_Pin){
	if (GPIO_Pin == GPIO_PIN_2){
		fsm.estado = cambio_opcion;
	}
	else if (GPIO_Pin == GPIO_PIN_5){
		//Apagamos el enable
		fsm.estado = apagarMotor;
	}
	else if (GPIO_Pin == GPIO_PIN_6){
		fsm.estado = reproducirAudio;

	}
	else if (GPIO_Pin == GPIO_PIN_7){
		//Apagamos el enable
		fsm.estado = apagarMotor;
	}
}
//Llamamos el callback para el blinky
void HAL_TIM_PeriodElapsedCallback(TIM_HandleTypeDef *htim){
	// Nos aseguramos de que sea el TIMER2 el que haga la interrupcion
    if (htim->Instance == TIM2){
    	//Cambiamos de estado a blinky
    	fsm.estado = Blinky;
    }
    else if (htim -> Instance ==TIM3){
    	contador ++;
    	fsm.estado = capitulo1;
    }
    else if (htim -> Instance ==TIM5){
    	contador ++;
    	fsm.estado = capitulo2;
    }
    else if (htim -> Instance ==TIM9){
    	contador ++;
    	fsm.estado = capitulo3;
    }
    else if (htim-> Instance == TIM10){
    	fsm.estado = apagarMotor;
    }
}
/* USER CODE END 4 */

/**
  * @brief  This function is executed in case of error occurrence.
  * @retval None
  */
void Error_Handler(void)
{
  /* USER CODE BEGIN Error_Handler_Debug */
  /* User can add his own implementation to report the HAL error return state */
  __disable_irq();
  while (1)
  {
  }
  /* USER CODE END Error_Handler_Debug */
}

#ifdef  USE_FULL_ASSERT
/**
  * @brief  Reports the name of the source file and the source line number
  *         where the assert_param error has occurred.
  * @param  file: pointer to the source file name
  * @param  line: assert_param error line source number
  * @retval None
  */
void assert_failed(uint8_t *file, uint32_t line)
{
  /* USER CODE BEGIN 6 */
  /* User can add his own implementation to report the file name and line number,
     ex: printf("Wrong parameters value: file %s on line %d\r\n", file, line) */
  /* USER CODE END 6 */
}
#endif /* USE_FULL_ASSERT */
